## boards/arm/imx8mp_debix_model_a/Kconfig.imx8mp_debix_model_a
```kconfig
# i.MX8MP Debix Model A board

# Copyright (c) 2023, Joris Offouga
# SPDX-License-Identifier: Apache-2.0

config BOARD_IMX8MP_DEBIX_MODEL_A
	bool "NXP i.MX8MP Debix Model A"
	select SOC_MIMX8ML8_M7
	select SOC_PART_NUMBER_MIMX8ML8DVNLZ
```

## boards/arm/imx8mp_debix_model_a/board.yml
```yaml
board:
  name: imx8mp_debix_model_a
  full_name: i.MX8MP Debix Model A
  vendor: nxp
  socs:
  - name: mimx8ml8
    variants:
    - name: smp
      cpucluster: a53
    - name: ddr
      cpucluster: m7
```

## boards/arm/imx8mp_debix_model_a/imx8mp_debix_model_a_m7_ddr_defconfig
```kconfig
#
# Copyright (c) 2026, Joris Offouga
#
# SPDX-License-Identifier: Apache-2.0
#

CONFIG_CLOCK_CONTROL=y
CONFIG_UART_CONSOLE=y
CONFIG_SERIAL=y
CONFIG_UART_INTERRUPT_DRIVEN=y
CONFIG_CONSOLE=y
CONFIG_RAM_CONSOLE=y
CONFIG_RAM_CONSOLE_BUFFER_SIZE=1024

# uart console (overrides remote proc console)
CONFIG_UART_CONSOLE=n
CONFIG_XIP=y
CONFIG_CODE_DDR=y
CONFIG_PINCTRL=y
```

## drivers/Kconfig
```kconfig
# SPDX-License-Identifier: Apache-2.0

menu "Drivers"

rsource "mfd/Kconfig"
rsource "adc/Kconfig"
rsource "dac/Kconfig"

endmenu
```

## drivers/adc/Kconfig
```kconfig
# SPDX-License-Identifier: Apache-2.0

config ADC_PCF8591
	bool "NXP PCF8591 ADC"
	default y
	depends on DT_HAS_NXP_PCF8591_ADC_ENABLED
	depends on ADC
	select MFD
	help
	  Enable the four 8-bit single-ended analog inputs of the NXP
	  PCF8591.

config ADC_PCF8591_INIT_PRIORITY
	int "NXP PCF8591 ADC init priority"
	default 80
	depends on ADC_PCF8591
	help
	  After the PCF8591 MFD (MFD_PCF8591_INIT_PRIORITY).
```

## drivers/dac/Kconfig
```kconfig
# SPDX-License-Identifier: Apache-2.0

config DAC_PCF8591
	bool "NXP PCF8591 DAC"
	default y
	depends on DT_HAS_NXP_PCF8591_DAC_ENABLED
	depends on DAC
	select MFD
	help
	  Enable the 8-bit analog output of the NXP PCF8591.

config DAC_PCF8591_INIT_PRIORITY
	int "NXP PCF8591 DAC init priority"
	default 80
	depends on DAC_PCF8591
	help
	  After the PCF8591 MFD (MFD_PCF8591_INIT_PRIORITY).
```

## drivers/mfd/Kconfig
```kconfig
# SPDX-License-Identifier: Apache-2.0

config MFD_PCF8591
	bool "NXP PCF8591 8-bit A/D and D/A converter"
	default y
	depends on DT_HAS_NXP_PCF8591_ENABLED
	depends on MFD
	select I2C
	help
	  Enable the NXP PCF8591 multi-function device driver: four 8-bit
	  analog inputs (ADC_PCF8591) and one 8-bit analog output
	  (DAC_PCF8591) on I2C.

config MFD_PCF8591_INIT_PRIORITY
	int "NXP PCF8591 init priority"
	default 75
	depends on MFD_PCF8591
	help
	  After the I2C bus, before the PCF8591 ADC and DAC
	  (ADC_PCF8591_INIT_PRIORITY, DAC_PCF8591_INIT_PRIORITY).
```

## dts/bindings/adc/nxp,pcf8591-adc.yaml
```yaml
# Copyright (c) 2026, Joris Offouga
# SPDX-License-Identifier: Apache-2.0

description: |
  NXP PCF8591 analog inputs AIN0-AIN3, 8-bit, single-ended. Child of an
  "nxp,pcf8591" node.

compatible: "nxp,pcf8591-adc"

include: adc-controller.yaml

properties:
  "#io-channel-cells":
    const: 1

io-channel-cells:
  - input
```

## dts/bindings/dac/nxp,pcf8591-dac.yaml
```yaml
# Copyright (c) 2026, Joris Offouga
# SPDX-License-Identifier: Apache-2.0

description: |
  NXP PCF8591 analog output AOUT, 8-bit, channel 0. Child of an
  "nxp,pcf8591" node.

compatible: "nxp,pcf8591-dac"

include: dac-controller.yaml

properties:
  "#io-channel-cells":
    const: 1

io-channel-cells:
  - output
```

## dts/bindings/mfd/nxp,pcf8591.yaml
```yaml
# Copyright (c) 2026, Joris Offouga
# SPDX-License-Identifier: Apache-2.0

description: |
  NXP PCF8591 8-bit A/D and D/A converter on I2C: four analog inputs
  (child "nxp,pcf8591-adc") and one analog output (child
  "nxp,pcf8591-dac").

  Example:

    pcf8591@48 {
      compatible = "nxp,pcf8591";
      reg = <0x48>;
      vref-mv = <3300>;

      pcf8591_adc: adc {
        compatible = "nxp,pcf8591-adc";
        #io-channel-cells = <1>;
      };

      pcf8591_dac: dac {
        compatible = "nxp,pcf8591-dac";
        #io-channel-cells = <1>;
      };
    };

compatible: "nxp,pcf8591"

include: i2c-device.yaml

properties:
  vref-mv:
    type: int
    default: 3300
    description: |
      Voltage on the VREF pin, in millivolts: full scale of the inputs
      and of the output (AGND to VREF).
```

## samples/warp7_io_board/sample.yaml
```yaml
sample:
  description: WaRP7 IO board devices (I2C3) driven by the Cortex-M4
  name: warp7 io board
common:
  tags: i2c sensor gpio eeprom counter
  harness: console
  extra_args: SNIPPET=warp7-io-board
tests:
  sample.warp7_io_board:
    platform_allow: warp7/mcimx7d/m4
```

## west.yml
```yaml
manifest:
  remotes:
    - name: zephyrproject-rtos
      url-base: https://github.com/zephyrproject-rtos

  projects:
    - name: zephyr
      remote: zephyrproject-rtos
      revision: v4.4-branch
      import: true

  self:
    path: zephyr-application
```
