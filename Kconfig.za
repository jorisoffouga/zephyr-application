## boards/arm/mimx8mp_debix/Kconfig.board
```kconfig
# MIMX8MP DEBIX board

# Copyright (c) 2023, Joris Offouga
# SPDX-License-Identifier: Apache-2.0

config BOARD_MIMX8MP_DEBIX
	bool "NXP i.MX8M Debix"
	depends on SOC_SERIES_IMX8ML_M7
	select SOC_PART_NUMBER_MIMX8ML8DVNLZ
```

## boards/arm/mimx8mp_debix/mimx8mp_debix_itcm_defconfig
```kconfig
#
# Copyright (c) 2021, Laird Connectivity
#
# SPDX-License-Identifier: Apache-2.0
#

CONFIG_SOC_SERIES_IMX8ML_M7=y
CONFIG_SOC_MIMX8ML8=y
CONFIG_BOARD_MIMX8MP_DEBIX=y
CONFIG_CLOCK_CONTROL=y
CONFIG_UART_CONSOLE=y
CONFIG_SERIAL=y
CONFIG_UART_INTERRUPT_DRIVEN=y
CONFIG_CONSOLE=y
CONFIG_RAM_CONSOLE=y
CONFIG_RAM_CONSOLE_BUFFER_SIZE=1024

# uart console (overrides remote proc console)
CONFIG_UART_CONSOLE=n
CONFIG_XIP=y
CONFIG_CODE_ITCM=y
CONFIG_PINCTRL=y
```

## boards/arm/pico_pi_m4/Kconfig.defconfig
```kconfig
# Kconfig - Pico-Pi iMX7D M4 board
#
# Copyright (c) 2018, Joris Offouga
#
# SPDX-License-Identifier: Apache-2.0
#

if BOARD_PICO_PI_M4

config BOARD
	default "pico_pi_m4"

if UART_IMX

config UART_IMX_UART_6
	default y

endif # UART_IMX

if I2C_IMX

config I2C_1
	default y

endif # I2C_IMX

if !XIP
config FLASH_SIZE
	default 0
config FLASH_BASE_ADDRESS
	default 0
endif

endif # BOARD_PICO_PI_M4
```

## boards/arm/stm32f4_disco_mikroe/Kconfig.board
```kconfig
# STM32F4DISCOVERY board configuration

# Copyright (c) 2020 Joris Offouga.
# SPDX-License-Identifier: Apache-2.0

config BOARD_STM32F4_DISCO_MIKROE
	bool "STM32F4DISCOVERY Development Board"
	depends on SOC_STM32F407XG
```

## boards/arm/stm32f4_disco_mikroe/Kconfig.defconfig
```kconfig
# STM32F4DISCOVERY board configuration

# Copyright (c) 2020 Joris Offouga.
# SPDX-License-Identifier: Apache-2.0

if BOARD_STM32F4_DISCO_MIKROE

config BOARD
	default "stm32f4_disco_mikroe"

endif # BOARD_STM32F4_DISCO_MIKROE
```

## drivers/sensor/Kconfig
```kconfig
menuconfig SENSOR
	bool "Sensor Drivers"
	help
		Include sensor drivers in config

if SENSOR

rsource "lm75a/Kconfig"

endif # SENSOR
```

## drivers/sensor/lm75a/Kconfig
```kconfig
# Kconfig.lm75a - LM75A Temperate Sensor 

#
# Copyright (c) 2019 Joris OFFOUGA
#
# SPDX-License-Identifier: Apache-2.0
#
menuconfig LM75A
	bool "LM75A sensor"
	depends on (I2C && HAS_DTS_I2C)
	help
		Enable driver for LM75A Temperate Sensor.
```

## dts/bindings/sensor/nxp,lm75a.yaml
```yaml
# Copyright (c) 2019, Joris OFFOUGA
# SPDX-License-Identifier: Apache-2.0

description: |
    LM75A Temperature Sensor

compatible: "nxp,lm75a"

include: i2c-device.yaml
```

## lib/Kconfig
```kconfig
menu "Addtional Librairies"

menuconfig CJSON
	bool"Ultralightweight JSON parser in ANSI C" 
	help
	  cJSON aims to be the dumbest possible parser that you can get your
	  job done with. It's a single file of C, and a single header file.

endmenu
```
