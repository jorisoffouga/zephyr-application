## CMakeLists.txt
```
cmake_minimum_required(VERSION 3.13.1)

find_package(Zephyr REQUIRED HINTS $ENV{ZEPHYR_BASE})
project(websocket_sensor)

FILE(GLOB app_sources src/*.cpp)
target_include_directories(app PRIVATE inc/)
target_sources(app PRIVATE ${app_sources})
```

## prj.conf
```kconfig
# CONFIG_NET_IPV6 is not set
CONFIG_MAIN_STACK_SIZE=8192
CONFIG_IDLE_STACK_SIZE=1024
CONFIG_SYSTEM_WORKQUEUE_STACK_SIZE=2048
CONFIG_HW_STACK_PROTECTION=y
CONFIG_SERIAL=y
CONFIG_LOG=y
CONFIG_CONSOLE=y
CONFIG_COMMON_LIBC_MALLOC_ARENA_SIZE=32768
CONFIG_BOOTLOADER_MCUBOOT=y
CONFIG_CJSON=y
CONFIG_MCUBOOT_SIGNATURE_KEY_FILE="/Users/jorisoffouga/workspace/zephyr-workspace/bootloader/mcuboot/root-rsa-2048.pem"
CONFIG_ARM_MPU=y
CONFIG_THREAD_LOCAL_STORAGE=y
# CONFIG_STATIC_INIT_GNU is not set
CONFIG_UART_CONSOLE=y
CONFIG_NEWLIB_LIBC=y
CONFIG_COMMON_LIBC_ASCTIME_R=y
CONFIG_COMMON_LIBC_CTIME_R=y
CONFIG_COMMON_LIBC_MALLOC=y
CONFIG_NEWLIB_LIBC_NANO=y
CONFIG_NEWLIB_LIBC_FLOAT_PRINTF=y
CONFIG_NEWLIB_LIBC_FLOAT_SCANF=y
CONFIG_CPP=y
CONFIG_STD_CPP17=y
CONFIG_REQUIRES_FULL_LIBCPP=y
CONFIG_POSIX_API=y
CONFIG_DEBUG_THREAD_INFO=y
CONFIG_LOG_BUFFER_SIZE=2048
CONFIG_NETWORKING=y
CONFIG_NET_TCP=y
# CONFIG_NET_UDP is not set
CONFIG_WEBSOCKET_CLIENT=y
CONFIG_NET_CONFIG_SETTINGS=y
CONFIG_NET_CONFIG_NEED_IPV4=y
CONFIG_NET_CONFIG_MY_IPV4_ADDR="192.168.1.11"
CONFIG_STATS=y
CONFIG_STATS_NAMES=y
CONFIG_ROM_END_OFFSET=0x2000
CONFIG_DEBUG_OPTIMIZATIONS=y
```

## boards/nucleo_f207zg.overlay
```dts
/{
    chosen {
        zephyr,code-partition = &slot0_partition;
    };    
};
```

## src/main.cpp
```c
#include <zephyr/kernel.h>
#include <zephyr/logging/log.h>
#include <zephyr/device.h>
#include <zephyr/net/net_mgmt.h>
#include <zephyr/net/net_if.h>

#include "../inc/websocket.hpp"

LOG_MODULE_REGISTER(main, LOG_LEVEL_INF);

K_SEM_DEFINE(sem, 0, 1);	/* starts off "not available" */

static void iface_event_handler(struct net_mgmt_event_callback *cb,
    uint32_t mgmt_event,
    struct net_if *iface)
{
    if (mgmt_event == NET_EVENT_IF_UP) {
        LOG_INF("Network interface is UP!");
        k_sem_give(&sem);
    } else if (mgmt_event == NET_EVENT_IF_DOWN) {
        LOG_INF("Network interface is DOWN!");
    }
}

int main (void)
{
    WebSocket ws("192.168.1.10", 8080, "/"); // Initialize WebSocket with appropriate parameters
    if (ws.init() != 1) {
        LOG_ERR("WebSocket initialization failed.");
        return -1;
    }
    k_sleep(K_SECONDS(5));

    LOG_INF("Finished init.");

    while (1) {

        std::string msg = ws.read_msg();
        if (!msg.empty()) {
            LOG_INF("Received message: %s", msg.c_str());
        }
        k_sleep(K_SECONDS(1));
    }
    return 0;
}
```

## inc/websocket.hpp
```c
#pragma once

#include <zephyr/kernel.h>
#include <zephyr/device.h>
#include <zephyr/net/net_ip.h>
#include <string>
#include <stdint.h>
#include <cJSON/cJSON.h>

#define MAX_RECV_BUF_LEN    (2048)
/* We need to allocate bigger buffer for the websocket data we receive so that
 * the websocket header fits into it.
 */
#define EXTRA_BUF_SPACE     (30)

class WebSocket {
public:
    WebSocket(std::string const& address, int const port, std::string const& path);
    ~WebSocket();
    int init(void);
    int send_msg(cJSON const*const message);
    int send_msg(std::string const& message);
    void read_msg(cJSON* message);
    std::string read_msg(void);
    std::string get_address(void) const { return m_address; }
    std::string get_path(void) const { return m_path; }
    int get_port(void) const { return m_port; }

private:
    int m_socket;
    int m_websocket;
    int32_t m_timeout;
    std::string m_path;
    int m_port;
    std::string m_address;
    uint8_t m_recv_buf[MAX_RECV_BUF_LEN];
    uint8_t m_temp_recv_buf[MAX_RECV_BUF_LEN + EXTRA_BUF_SPACE];
    struct sockaddr_in m_addr;

    static int connect_cb(int sock, struct http_request *req, void *user_data);
};
```

## src/websocket.cpp
```c
#include <zephyr/net/socket.h>
#include <zephyr/net/net_mgmt.h>
#include <zephyr/net/websocket.h>
#include <zephyr/logging/log.h>

#include "../inc/websocket.hpp"

LOG_MODULE_REGISTER(websocket, LOG_LEVEL_INF);

static uint8_t recv_buf[MAX_RECV_BUF_LEN];
static uint8_t temp_recv_buf[MAX_RECV_BUF_LEN + EXTRA_BUF_SPACE];

WebSocket::WebSocket(std::string const& address, int const port, std::string const& path)
    : m_socket(-1), m_websocket(-1), m_timeout(3 * MSEC_PER_SEC), m_path(path), m_port(port), m_address(address)
{
}

WebSocket::~WebSocket()
{
    if (m_websocket >= 0) {
        websocket_disconnect(m_websocket);
    }
    if (m_socket >= 0) {
        close(m_socket);
    }
}

int WebSocket::init(void)
{
    int ret = -1;
    struct websocket_request req;
    memset(&req, 0, sizeof(req));
    req.host = m_address.c_str();
    req.url = m_path.c_str();
    req.cb = connect_cb;
    req.tmp_buf = temp_recv_buf;
    req.tmp_buf_len = sizeof(temp_recv_buf);
    socklen_t addr_len = sizeof(m_addr);

    if (!IS_ENABLED(CONFIG_NET_IPV4)) {
        return 1;
    }

    if (m_address.empty() || m_path.empty()) {
        LOG_ERR("Invalid address or path");
        return -1;
    }
    if (m_port <= 0) {
        LOG_ERR("Invalid port");
        return -1;
    }

    if (m_websocket >= 0) {
        websocket_disconnect(m_websocket);
    }

    if (m_socket >= 0) {
        close(m_socket);
    }

    memset(&m_addr, 0, addr_len);

    net_sin(reinterpret_cast<struct sockaddr*>(&m_addr))->sin_family = AF_INET;
    net_sin(reinterpret_cast<struct sockaddr*>(&m_addr))->sin_port = htons(m_port);
    inet_pton(AF_INET, m_address.c_str(), &net_sin(reinterpret_cast<struct sockaddr*>(&m_addr))->sin_addr);

    m_socket = socket(AF_INET, SOCK_STREAM, IPPROTO_TCP);

    if (m_socket < 0) {
        LOG_ERR("Failed to create IPv4 HTTP socket (%d)", -errno);
        return -1;
    }

    ret = connect(m_socket, reinterpret_cast<struct sockaddr*>(&m_addr), addr_len);
    if (ret < 0) {
        LOG_ERR("Cannot connect to IPv4 remote (%d)", -errno);
        ret = -errno;
    }
    LOG_INF("Connected to %s:%d", m_address.c_str(), m_port);

    m_websocket = websocket_connect(m_socket, &req, m_timeout, this);

    if (m_websocket < 0) {
        LOG_ERR("Cannot connect Websocket to %s:%d", m_address.c_str(), m_port);
        close(m_socket);
        return 0;
    }

    LOG_INF("Websocket %d", m_websocket);
    return 1;
}

int WebSocket::send_msg(std::string const& message)
{
    int ret = 0;
    if (!IS_ENABLED(CONFIG_NET_IPV4)) {
        return -1;
    }

    if (message.empty()) {
        LOG_WRN("Message empty!");
        return -1;
    }
    size_t len = message.length();
    if (!m_websocket) {
        LOG_ERR("Socket not configured!");
        return -1;
    }
    ret = websocket_send_msg(m_websocket, (uint8_t*)message.c_str(), len,
                             WEBSOCKET_OPCODE_DATA_TEXT,
                             true, true, 0);
    if ((size_t)ret != len) {
        LOG_WRN("Failed to send!");
        return -1;
    }
    return ret;
}

int WebSocket::send_msg(cJSON const*const message)
{
    int ret = 0;
    if (!IS_ENABLED(CONFIG_NET_IPV4)) {
        return -1;
    }

    if (!message) {
        LOG_WRN("Message empty!");
        return -1;
    }
    char * buf = cJSON_PrintUnformatted(message);
    if (buf) {
        if (!m_websocket) {
            LOG_ERR("Socket not configured!");
            free(buf);
            return -1;
        }
        ret = send_msg(std::string(buf));
        free(buf);
    }
    return ret;
}

void WebSocket::read_msg(cJSON* message)
{
    std::string received_data = read_msg();
    if (received_data.empty()) {
        LOG_ERR("Failed to receive data");
        return;
    }

    message = cJSON_Parse(received_data.c_str());

    if (!message) {
        LOG_ERR("Failed to parse JSON message");
        return;
    }
    if (cJSON_GetArraySize(message) == 0) {
        LOG_ERR("Empty JSON message");
        cJSON_Delete(message);
        return;
    }
}

std::string WebSocket::read_msg(void)
{
    uint64_t remaining = ULONG_MAX;
    int total_read;
    uint32_t message_type;
    int ret, read_pos;

    read_pos = 0;
    total_read = 0;
    size_t buf_len = sizeof(m_recv_buf);

    if (!IS_ENABLED(CONFIG_NET_IPV4)) {
        return std::string();
    }

    if (!m_websocket) {
        LOG_ERR("Socket not configured!");
        return std::string();
    }

    while (remaining > 0) {
        ret = websocket_recv_msg(m_websocket, m_recv_buf + read_pos,
            buf_len - read_pos,
            &message_type,
            &remaining,
            m_timeout);
        if (ret < 0) {
            if (ret == -EAGAIN) {
                k_sleep(K_MSEC(50));
                continue;
            }
            LOG_INF("IPv4 connection closed while waiting (%d/%d)", ret, errno);
            break;
        }

        read_pos += ret;
        total_read += ret;
    }

    if (remaining != 0) {
        LOG_ERR("IPv4 data recv failure %zd/%d bytes (remaining %" PRId64 ")",
                buf_len, total_read, remaining);
    } else {
        LOG_DBG("IPv4 recv %d bytes", total_read);
    }
    if (total_read > 0) {
        m_recv_buf[total_read] = '\0';
        return std::string((char*)m_recv_buf);
    }
    return std::string();
}

int WebSocket::connect_cb(int sock, struct http_request *req, void *user_data)
{
    if (!user_data) {
        return 0;
    }
    WebSocket *ws = reinterpret_cast<WebSocket *>(user_data);
    LOG_INF("Websocket %d for %s connected.", sock, ws->get_address().c_str());
    return 0;
}
```
