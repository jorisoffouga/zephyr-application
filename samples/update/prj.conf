## CMakeLists.txt
```
cmake_minimum_required(VERSION 3.13.1)

find_package(Zephyr REQUIRED HINTS $ENV{ZEPHYR_BASE})
project(Update)

target_include_directories(app PRIVATE $ENV{ZEPHYR_BASE}/lib/updatehub/include)
target_sources(app PRIVATE src/main.c)

if(CONFIG_UPDATEHUB_DTLS)
    foreach(inc_file
            servercert.der
            privkey.der
            )
        generate_inc_file_for_target(
            ${ZEPHYR_CURRENT_LIBRARY}
            src/certificates/${inc_file}
            ${gen_dir}/${inc_file}.inc
            )
    endforeach()
endif()
```

## prj.conf
```kconfig
CONFIG_UPDATEHUB=y

#Minimal Heap mem pool size for the updatehub working
CONFIG_HEAP_MEM_POOL_SIZE=2048
CONFIG_SYSTEM_WORKQUEUE_STACK_SIZE=2048

CONFIG_NET_IPV4=y
CONFIG_NET_CONFIG_NEED_IPV4=y

CONFIG_NET_IPV6=n
CONFIG_NET_CONFIG_SETTINGS=y
CONFIG_NET_CONFIG_MY_IPV6_ADDR="2001:db8::1"
CONFIG_NET_CONFIG_PEER_IPV6_ADDR="2001:db8::2"

CONFIG_NET_CONFIG_MY_IPV4_ADDR="192.168.20.150"
CONFIG_NET_CONFIG_PEER_IPV4_ADDR="192.168.20.151"
CONFIG_NET_DHCPV4=y

#Optional if you would like test on the your server
#CONFIG_SHELL
#CONFIG_UPDATEHUB_SHELL
#CONFIG_NET_SHELL

# Debug helpers
#CONFIG_LOG=y
#CONFIG_UPDATEHUB_LOG_LEVEL_INF=y

#Example of product_uid, you must set you product uid.
CONFIG_UPDATEHUB_PRODUCT_UID="e4d37cfe6ec48a2d069cc0bbb8b078677e9a0d8df3a027c4d8ea131130c4265f"

#If you use the autorandler, need set UPDATEHUB_POLL_INTERVAL.
#This example, the updatehub will poll on the server
#request for updates one to one minute.
#(min: 0 minute, máx: 30 days)
CONFIG_UPDATEHUB_POLL_INTERVAL=1

CONFIG_UPDATEHUB_CE=y

#You need set the updatehub-ce ip Address.
#This is a example of ip address
CONFIG_UPDATEHUB_SERVER="192.168.20.151"

CONFIG_BOOTLOADER_MCUBOOT=y
```

## src/main.c
```c
/*
 * Copyright (c) 2020 Joris Offouga
 *
 * SPDX-License-Identifier: Apache-2.0
 */

#include <zehphyr/kernel.h>
#include <updatehub.h>
#include <dfu/mcuboot.h>
#include <zephyr/drivers/gpio.h>
#include <sys/printk.h>
#include <zephyr/logging/log.h>

#if defined(CONFIG_UPDATEHUB_DTLS)
#include <net/tls_credentials.h>
#include "c_certificates.h"
#endif

#define LED_PORT DT_ALIAS_LED0_GPIOS_CONTROLLER
#define LED DT_ALIAS_LED0_GPIOS_PIN

/* 1000 msec = 1 sec */
#define SLEEP_TIME 1000

LOG_MODULE_REGISTER(main);

void main(void)
{
	int ret = -1;
	int cnt = 0;
	struct device *dev;

	dev = device_get_binding(LED_PORT);
	/* Set LED pin as output */
	gpio_pin_configure(dev, LED, GPIO_DIR_OUT);


#if defined(CONFIG_UPDATEHUB_DTLS)
	if (tls_credential_add(CA_CERTIFICATE_TAG,
			       TLS_CREDENTIAL_SERVER_CERTIFICATE,
			       server_certificate,
			       sizeof(server_certificate)) < 0) {
		LOG_ERR("Failed to register server certificate");
		return;
	}

	if (tls_credential_add(CA_CERTIFICATE_TAG,
			       TLS_CREDENTIAL_PRIVATE_KEY,
			       private_key,
			       sizeof(private_key)) < 0) {
		LOG_ERR("Failed to register private key");
		return;
	}
#endif

	/* The image of application needed be confirmed */
	LOG_INF("Confirming the boot image");
	ret = boot_write_img_confirmed();
	if (ret < 0) {
		LOG_ERR("Error to confirm the image");
	}


	LOG_INF("Starting UpdateHub polling mode");
	updatehub_autohandler();

	while (1)
	{
		/* Set pin to HIGH/LOW every 1 second */
		gpio_pin_write(dev, LED, cnt % 2);
		cnt++;
		k_sleep(Z_TIMEOUT_TICKS(SLEEP_TIME));
	}
}
```
