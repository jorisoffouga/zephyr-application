## CMakeLists.txt
```
cmake_minimum_required(VERSION 3.13.1)

find_package(Zephyr REQUIRED HINTS $ENV{ZEPHYR_BASE})
project(qt_project)

FILE(GLOB app_sources src/*.c)
target_sources(app PRIVATE ${app_sources})
```

## prj.conf
```kconfig
CONFIG_GPIO=y
CONFIG_UART_INTERRUPT_DRIVEN=y
CONFIG_HEAP_MEM_POOL_SIZE=256
CONFIG_ASSERT=y
CONFIG_PRINTK=y
```

## stm32f4_disco.overlay
```dts
/{
    aliases {
        led0 = &green_led_4;
        led1 = &orange_led_3;
        led2 = &red_led_5;
        led3 = &blue_led_6;
    };
};
```

## src/main.c
```c
#include <zephyr/kernel.h>
#include <zephyr/device.h>
#include <zephyr/drivers/gpio.h>
#include <zephyr/drivers/uart.h>
#include <sys/printk.h>
#include <sys/__assert.h>
#include <string.h>
#include "util.h"

#define LED_PORT DT_ALIAS_LED0_GPIOS_CONTROLLER
#define LED0 DT_ALIAS_LED0_GPIOS_PIN
#define LED1 DT_ALIAS_LED1_GPIOS_PIN
#define LED2 DT_ALIAS_LED2_GPIOS_PIN
#define LED3 DT_ALIAS_LED3_GPIOS_PIN
#define UART_PORT "UART_2"
#define SW_PORT DT_ALIAS_SW0_GPIOS_CONTROLLER
#define SW_PIN DT_ALIAS_SW0_GPIOS_PIN
#define EDGE (GPIO_INT_EDGE | GPIO_INT_ACTIVE_LOW)

#define PULL_UP 0

/* size of stack area used by each thread */
#define STACKSIZE 1024

/* scheduling priority used by each thread */
#define PRIORITY 7

/* Callback function*/
typedef void (*callback_t)(struct device *port,
				   struct gpio_callback *cb, uint32_t pins);

static struct bridge_t bridge;

static struct gpio_callback gpio_cb;

/* Initialiase Fifo*/
K_FIFO_DEFINE(uart_fifo);

/* Uart rx callback*/
static void uart_irq_callback(struct device *uart)
{
	int rx;
	char buffer[255];

	while (uart_irq_update(uart) &&
		   uart_irq_is_pending(uart))
	{

		if (!uart_irq_rx_ready(uart))
		{
			if (uart_irq_tx_ready(uart))
			{
				/* Nothing to do*/
			}
			else
			{
				/* Nothing to do*/
			}
			/* Only the UART RX path is interrupt-enabled */
			break;
		}

		/* Read character and send to mainthead with fifo */
		rx = uart_fifo_read(uart, buffer, 1);
		struct fifo_data_t data = {.data = buffer};
		size_t size = sizeof(struct fifo_data_t);
		char *mem_ptr = k_malloc(size);
		__ASSERT_NO_MSG(mem_ptr != 0);

		memcpy(mem_ptr, &data, size);

		k_fifo_put(&uart_fifo, mem_ptr);
	}
}

/* Gpio interrupt callback */
void gpio_callback(struct device *port,
				   struct gpio_callback *cb, uint32_t pins)
{
	struct bridge_t *dev = &bridge;

	gpio_pin_toggle(dev->gpio.handle, LED0);
	gpio_pin_toggle(dev->gpio.handle, LED1);
	gpio_pin_toggle(dev->gpio.handle, LED2);
	gpio_pin_toggle(dev->gpio.handle, LED3);
}

/* Thread */
static void MainThread(void)
{

	struct bridge_t *dev = &bridge;
	struct device *sw_dev;
	callback_t gpioCallback = gpio_callback;

	/* Enable gpio interrupt */
	sw_dev = device_get_binding(SW_PORT);
	__ASSERT_NO_MSG(sw_dev != NULL);

	gpio_pin_configure(sw_dev, SW_PIN, GPIO_DIR_IN | GPIO_INT | PULL_UP | EDGE);
	gpio_init_callback(&gpio_cb, gpioCallback, BIT(SW_PIN));
	gpio_add_callback(sw_dev, &gpio_cb);
	gpio_pin_enable_callback(sw_dev, SW_PIN);

	/* Set LED pin as output */
	dev->gpio.handle = device_get_binding(LED_PORT);
	__ASSERT_NO_MSG(dev->gpio.handle != NULL);

	gpio_pin_configure(dev->gpio.handle, LED0, GPIO_DIR_OUT);
	gpio_pin_configure(dev->gpio.handle, LED1, GPIO_DIR_OUT);
	gpio_pin_configure(dev->gpio.handle, LED2, GPIO_DIR_OUT);
	gpio_pin_configure(dev->gpio.handle, LED3, GPIO_DIR_OUT);

	/* uart setup */
	dev->uart.handle = device_get_binding(UART_PORT);
	__ASSERT_NO_MSG(dev->uart.handle != NULL);

	uart_irq_rx_disable(dev->uart.handle);
	uart_irq_tx_disable(dev->uart.handle);
	uart_irq_callback_set(dev->uart.handle, uart_irq_callback);
	uart_irq_rx_enable(dev->uart.handle);

	while (1)
	{
		struct fifo_data_t *data = k_fifo_get(&uart_fifo, K_FOREVER);
		switch (*data->data)
		{
		case 0x30:
			gpio_pin_toggle(dev->gpio.handle, LED3);
			break;
		case 0x31:
			gpio_pin_toggle(dev->gpio.handle, LED0);
			break;
		case 0x32:
			gpio_pin_toggle(dev->gpio.handle, LED1);
			break;
		case 0x33:
			gpio_pin_toggle(dev->gpio.handle, LED2);
			break;
		default:
			break;
		}
		k_free(data);
		k_sleep(Z_TIMEOUT_TICKS(500));
	}
}

/* Initialiase Thread */
K_THREAD_DEFINE(MainThread_id, STACKSIZE, MainThread, NULL, NULL, NULL, PRIORITY, 0, 0);
```

## src/util.c
```c
#include "util.h"
#include <drivers/gpio.h>

/*
	Inverse state of pin
*/
void gpio_pin_toggle(struct device *port, uint32_t pin)
{
	uint32_t value = 0;
	uint8_t ret = gpio_pin_read(port, pin, &value);

	if (ret < 0)
	{
		printk("Error gpio read");
		return;
	}

	if (value)
	{
		gpio_pin_write(port, pin, 0);
		printk("Turn Off gpio %d\n", pin);
	}
	else
	{
		gpio_pin_write(port, pin, 1);
		printk("Turn on gpio %d\n", pin);
	}
}
```

## src/util.h
```c
#ifndef UTIL_H
#define UTIL_H

#include <zephyr/kernel.h>
#include <zephyr/device.h>

void gpio_pin_toggle(struct device *port, uint32_t pin);

struct fifo_data_t
{
	void *fifo_reserved;
	uint8_t *data;
};

struct bridge_t
{
	struct
	{
		struct device *handle;
	} uart;

	struct
	{
		struct device *handle;
	} gpio;
};


#endif //UTIL_H
```
