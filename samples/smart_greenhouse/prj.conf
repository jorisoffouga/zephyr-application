## CMakeLists.txt
```
cmake_minimum_required(VERSION 3.13.1)

find_package(Zephyr REQUIRED HINTS $ENV{ZEPHYR_BASE})
project(smart_greenhouse)

FILE(GLOB app_sources src/*.c)
include_directories(inc)
target_sources(app PRIVATE ${app_sources})
```

## prj.conf
```kconfig
CONFIG_I2C=y
CONFIG_SENSOR=y
CONFIG_BME280=y
CONFIG_UART_INTERRUPT_DRIVEN=y
CONFIG_PRINTK=y
```

## prj_stm32f4_disco_mikroe.conf
```kconfig
CONFIG_I2C=y
CONFIG_I2C_1=y
CONFIG_SENSOR=y
CONFIG_BME280=y
CONFIG_UART_INTERRUPT_DRIVEN=y
CONFIG_PRINTK=y
#Minimal Heap mem pool size for the updatehub working
CONFIG_HEAP_MEM_POOL_SIZE=2048
CONFIG_SYSTEM_WORKQUEUE_STACK_SIZE=2048
```

## src/main.c
```c
#include <zephyr.h>
#include <device.h>
#include <drivers/sensor.h>
#include <drivers/uart.h>

#include "message.h"

#define UART_PORT DT_LABEL(DT_NODELABEL(usart2))
#define BME280	"BME280"
#define SOF 0x55
#define SIZE(a) sizeof (a) / sizeof *(a)

static void uart_send(struct device *uart, int8_t* data, uint8_t len){

	for (uint8_t i = 0; i < len; i++)
	{
		uart_poll_out(uart, data[i]);
	}
}

static void send_message(struct device *uart, struct sensor_value *value, uint8_t id)
{
	uint8_t *rawMsg;
	size_t len;
	//message_t *msg = NULL;
	message_t msg;

	memset(&msg, 0, sizeof(struct sensor_value) + sizeof(message_t));
	uint16_t rawValue = (value->val1 * 10^(6)) + (uint16_t)(value->val2);

	//msg.dataPtr = &msg.data.datagen;

	//msg = message_alloc(sizeof(struct sensor_value));

	// if (msg =! NULL)
	// {
	// 	message_init(msg);
	// }else{
	// 	printk("Memory Alloc fail");
	// 	return;
	// }

	msg.cmd = CMD_EVENT;
	msg.id = (id_t) (id);
	msg.status = MSG_STATE_SUCCESS;

	switch (msg.id)
	{
	case ID_TEMP:
		msg.data.temp.degrees = rawValue;
		msg.dataLen = sizeof(msg.data.temp);
		printk("Temperature reel %d, Temperature  %d.%d\n ", rawValue, value->val1, value->val2);
		break;
	case ID_HUMIDITY:
		msg.data.humidity.percents = rawValue;
		msg.dataLen = sizeof(msg.data.humidity);
		printk("Humidity reel %d, Humidity  %d.%d\n ", rawValue, value->val1, value->val2);
		break;
	case ID_PRESSURE:
		msg.data.pressure.bar = rawValue;
		msg.dataLen = sizeof(msg.data.pressure);
		printk("Pressure reel %d, Pressure  %d.%d\n ", rawValue, value->val1, value->val2);
		break;
	default:
		break;
	}

	// len = message_compose(&rawMsg, &msg);

	// if (len != 0 )
	// {
	// 	k_free(rawMsg);
	// 	//message_free(msg);
	// 	//uart_send(uart, rawMsg, len);
	// }
}

void main(void)
{
	struct device *bme280 = device_get_binding(BME280);
	struct device *uart_handle = device_get_binding(UART_PORT);
	struct sensor_value bme280_data[3];

	//printk("")
	if (uart_handle == NULL) {
		printk("Could not get UART_2 device\n");
		return;
	}

	if (bme280 == NULL) {
		printk("Could not get BME280 device\n");
		return;
	}

	printk("dev %p name %s\n", bme280, bme280->config->name);

	while (1) {
		sensor_sample_fetch(bme280);
		sensor_channel_get(bme280, SENSOR_CHAN_AMBIENT_TEMP, &bme280_data[0]);
		sensor_channel_get(bme280, SENSOR_CHAN_PRESS, &bme280_data[1]);
		sensor_channel_get(bme280, SENSOR_CHAN_HUMIDITY, &bme280_data[2]);

		for (uint8_t i = 0; i < 3; i++)
		{
			send_message(uart_handle, &bme280_data[i], i);
			k_sleep(K_MSEC(1000));
		}
	}
}
```

## inc/message.h
```c
#ifndef MESSAGE_H_
#define MESSAGE_H_

#include <zephyr.h>
#include <string.h>
#include <stddef.h>

/*
 * Format:
 *
 * Fields: |   SOF    |  len  |   id   |  cmd  |  status | data |
 * nBytes: |   0x55   |   1   |   1    |   1   |   1     |  N   |
 *
 * id: Unique identifier
 * cmd: Command
 * status:  Response status
 * data:    Payload
 * len: Payload Len
 */

typedef enum
{
	CMD_GET_VALUE,
	CMD_SET_VALUE,
	CMD_EVENT,
}command_t;

typedef enum message_status_e
{
	MSG_STATE_SUCCESS,
	MSG_STATE_FAIL,
}message_status_t;

typedef enum
{
    ID_TEMP,
    ID_PRESSURE,
    ID_HUMIDITY,
    ID_LED
}id_t;

typedef union
{
    /* Representation of sensor union*/
    uint8_t datagen;
    
    struct {
        uint16_t degrees;
    }temp;

    struct {
        uint16_t percents;
    }humidity;

    struct{
        uint16_t bar;
    }pressure;

}sensor_t;


typedef struct __attribute__((packed, aligned(1)))message_header_s
{
	id_t id;
	command_t cmd;
	message_status_t status;
	uint8_t dataLen;
    uint8_t *dataPtr;
    sensor_t data;
}message_t;

/*
 * @param head
 * @param data
 * @param msgRaw
 * return  size
 */
//void message_init():

/*
 * @param head
 * @param msgRaw
 * return  size
 */
size_t message_compose(uint8_t **msgRaw, message_t *msg);

/*
 * @param rawData
 * return  msg
 */
message_t *message_parse(uint8_t *rawData);

/*
 * @param rawData
 * return  message_t *
 */
message_t *message_alloc(uint8_t size);

/*
 * @param msg
 */
void message_free(message_t *msg);

#endif
```

## src/message.c
```c
#include "message.h"

#define INDEXDATA 5
#define MESSAGEMINSIZE INDEXDATA
#define STARTOFFRAME 0x55
#define INDEXSTARTOFFRAME 0
#define INDEXSIZE 1
#define INDEXID 2
#define INDEXCMD  3
#define INDEXSTATUS 4


size_t message_compose(uint8_t **msgRaw, message_t *msg)
{
	uint8_t *rawMsg;

	rawMsg = k_malloc(msg->dataLen + MESSAGEMINSIZE);

	if (rawMsg == NULL)
    {
        goto error;
    } else {
        memset(rawMsg, 0, msg->dataLen + MESSAGEMINSIZE);
    }

	rawMsg[INDEXSTARTOFFRAME] = (uint8_t) STARTOFFRAME;
	rawMsg[INDEXSIZE] = (uint8_t) msg->dataLen;
	rawMsg[INDEXID]  = (uint8_t) msg->id;
	rawMsg[INDEXCMD] = (uint8_t) msg->cmd;
	rawMsg[INDEXSTATUS] = (uint8_t) msg->status;

	if(msg->dataPtr != NULL && msg->dataLen != 0)
	{
		for (uint8_t i = 0; i < msg->dataLen; ++i) {
			rawMsg[INDEXDATA + i] = msg->dataPtr[i];
		}
	}

	*msgRaw = rawMsg;

	if (*msgRaw != NULL) {
		return MESSAGEMINSIZE + msg->dataLen;
	} else {
		goto error;
	}

error:
	k_free(rawMsg);
	return 0;
}

message_t *message_parse(uint8_t *rawData)
{
    message_t *msg;
	uint8_t *temp;

	if (rawData[INDEXSTARTOFFRAME] != STARTOFFRAME)
		goto error;

    msg = message_alloc(rawData[INDEXSIZE] + sizeof(message_t));

    if (msg == NULL)
        goto error;

    msg->dataLen = (uint8_t ) rawData[INDEXSIZE];
	msg->id = (id_t) rawData[INDEXID];
	msg->cmd =  (command_t) rawData[INDEXCMD];
	msg->status = (message_status_t) rawData[INDEXSTATUS];

	temp = k_malloc(msg->dataLen);

	if (temp == NULL)
		goto error;

	memcpy(temp, rawData + INDEXDATA, msg->dataLen);

	msg->dataPtr = temp;

	return msg;

error:
	k_free(temp);
	message_free(msg);
	return NULL;

}

void message_init(message_t *msg)
{
	if(msg != NULL)
	{
		msg->dataPtr = &msg->data.datagen;
	}
}

message_t *message_alloc(uint8_t size)
{
    message_t *msg;
	size_t msgSize = size + sizeof(message_t);

    msg = k_malloc(msgSize);

    if (msg != NULL) {
        memset(msg, 0, msgSize);
    }

	return msg;
}

void message_free(message_t *msg)
{
    k_free(msg);
}
```
