/*
 * Copyright (c) 2026, Joris Offouga
 * SPDX-License-Identifier: Apache-2.0
 *
 */

#include <nxp/nxp_imx/mimx8ml8dvnlz-pinctrl.dtsi>

&pinctrl {
	uart3_default: uart3_default {
		group0 {
			pinmux = <&iomuxc_uart3_rxd_uart_rx_uart3_rx>,
				<&iomuxc_uart3_txd_uart_tx_uart3_tx>;
			bias-pull-up;
			slew-rate = "slow";
			drive-strength = "x1";
		};
	};

};
